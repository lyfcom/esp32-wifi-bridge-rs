## sdkconfig.defaults
```kconfig
# Rust main task stack size
CONFIG_ESP_MAIN_TASK_STACK_SIZE=8000

# FreeRTOS tick frequency (1000 Hz for 1ms precision)
CONFIG_FREERTOS_HZ=1000

# CPU Frequency - Maximum 240MHz for best performance
CONFIG_ESP32_DEFAULT_CPU_FREQ_MHZ=240
CONFIG_ESP32_DEFAULT_CPU_FREQ_240=y

# Compiler optimization for performance
CONFIG_COMPILER_OPTIMIZATION_PERF=y
CONFIG_COMPILER_OPTIMIZATION_ASSERTIONS_DISABLE=y

# WiFi Configuration - Enhanced performance
CONFIG_ESP32_WIFI_STATIC_RX_BUFFER_NUM=16
CONFIG_ESP32_WIFI_DYNAMIC_RX_BUFFER_NUM=64
CONFIG_ESP32_WIFI_DYNAMIC_TX_BUFFER_NUM=64
CONFIG_ESP32_WIFI_TX_BUFFER_TYPE=1
CONFIG_ESP32_WIFI_AMPDU_TX_ENABLED=y
CONFIG_ESP32_WIFI_AMPDU_RX_ENABLED=y
CONFIG_ESP32_WIFI_AMSDU_TX_ENABLED=y
CONFIG_ESP32_WIFI_RX_BA_WIN=32
CONFIG_ESP32_WIFI_NVS_ENABLED=y

# Enable IP forwarding and NAT
CONFIG_LWIP_IP_FORWARD=y
CONFIG_LWIP_IPV4_NAPT=y

# LWIP Performance Optimization
CONFIG_LWIP_MAX_SOCKETS=16
CONFIG_LWIP_SO_REUSE=y
CONFIG_LWIP_SO_RCVBUF=y
CONFIG_LWIP_TCP_MSS=1460
CONFIG_LWIP_TCP_SND_BUF_DEFAULT=5760
CONFIG_LWIP_TCP_WND_DEFAULT=5760
CONFIG_LWIP_TCP_RECVMBOX_SIZE=12
CONFIG_LWIP_UDP_RECVMBOX_SIZE=12
CONFIG_LWIP_TCPIP_RECVMBOX_SIZE=64
CONFIG_LWIP_ETHARP_TRUST_IP_MAC=y

# TCP Performance
CONFIG_LWIP_TCP_SYNMAXRTX=6
CONFIG_LWIP_TCP_MAXRTX=12
CONFIG_LWIP_TCPIP_TASK_STACK_SIZE=4096

# Memory optimization for relay
CONFIG_LWIP_MEM_DEFAULT_MEMPOOL_SEGMENTS=1

# Task Watchdog
CONFIG_ESP_TASK_WDT_TIMEOUT_S=10

# Anti-Detection Configuration (Bypass hotspot sharing detection)
# Allow forwarding on RX interface (for TTL modification)
CONFIG_LWIP_IP_FORWARD_ALLOW_TX_ON_RX_NETIF=y

# Workaround for https://github.com/espressif/esp-idf/issues/7631
#CONFIG_MBEDTLS_CERTIFICATE_BUNDLE=n
#CONFIG_MBEDTLS_CERTIFICATE_BUNDLE_DEFAULT_FULL=n
```
